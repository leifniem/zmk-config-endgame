/ {
  combos {
    compatible = "zmk,combos";

    COMBO(Left_Square_Bracket, &kp LEFT_BRACKET,2 3);
    COMBO(Right_Square_Bracket, &kp RIGHT_BRACKET,6 7);
    COMBO(Backspace, &kp BKSP,8 9);
    COMBO(Tab, &kp TAB, 12 13);
    COMBO(Slash, &kp SLASH, 17 18);
    COMBO(Quote, &kp SQT, 26 27);
    COMBO(Backslash, &kp BSLH, 22 23);
    // COMBO(Hyper, &kp LG(LA(LCTRL)), 33 34);
  };
};
